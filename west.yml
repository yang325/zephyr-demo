## west.yml
```yaml
# demo/west.yml:
manifest:
  remotes:
    - name: zephyrproject-rtos
      url-base: https://github.com/zephyrproject-rtos
    - name: myproject
      url-base: https://github.com/yang325
  projects:
    - name: zephyr
      remote: zephyrproject-rtos
      import: true
    - name: ble_gamepad
      remote: myproject
      path: demo/gamepad
    - name: mesh_lamp
      remote: myproject
      path: demo/lamp
  self:
    path: project
```
